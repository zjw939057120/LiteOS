## targets/Kconfig.gd
```kconfig
config LOSCFG_PLATFORM
    string
    default "GD32E103C_START"       if LOSCFG_PLATFORM_GD32E103C_START
    default "GD32F303ZET6"   if LOSCFG_PLATFORM_GD32F303ZET6
    default "GD32F470IGH6"   if LOSCFG_PLATFORM_GD32F470IGH6
    default "GD32VF103V_EVAL"       if LOSCFG_PLATFORM_GD32VF103V_EVAL

choice
    prompt "Target"
    depends on LOSCFG_FAMILY_GD
    default LOSCFG_PLATFORM_GD32E103C_START
    help
      GD32E103C_START
      GD32F303ZET6
      GD32F470IGH6
      GD32VF103V_EVAL

config LOSCFG_PLATFORM_GD32E103C_START
    bool "GD32E103C_START"
    select LOSCFG_USING_BOARD_LD
    select LOSCFG_ARCH_CORTEX_M4
    select LOSCFG_CORTEX_M_NVIC
    select LOSCFG_CORTEX_M_SYSTICK
    select LOSCFG_DRIVER_GD_LIB

config LOSCFG_PLATFORM_GD32F303ZET6
    bool "GD32F303ZET6"
    select LOSCFG_USING_BOARD_LD
    select LOSCFG_ARCH_CORTEX_M4
    select LOSCFG_CORTEX_M_NVIC
    select LOSCFG_CORTEX_M_SYSTICK
    select LOSCFG_DRIVER_GD_LIB


config LOSCFG_PLATFORM_GD32F470IGH6
    bool "GD32F470IGH6"
    select LOSCFG_USING_BOARD_LD
    select LOSCFG_ARCH_CORTEX_M4
    select LOSCFG_CORTEX_M_NVIC
    select LOSCFG_CORTEX_M_SYSTICK
    select LOSCFG_DRIVER_GD_LIB

config LOSCFG_PLATFORM_GD32VF103V_EVAL
    bool "GD32VF103V_EVAL"
    select LOSCFG_USING_BOARD_LD
    select LOSCFG_ARCH_RISCV_RV32IMC
    select LOSCFG_RISCV32_M_TIMER
    select LOSCFG_PLATFORM_BSP_RISCV_ECLIC
    select LOSCFG_DRIVER_GD_LIB

endchoice
```
